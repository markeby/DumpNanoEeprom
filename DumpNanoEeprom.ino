//#############################################################
//# file:        DumpNanoEeprom.ino                           #
//# version:     0.9.0                                        #
//# author:      Mark Ebersole                                #
//#              MLE Tech                                     #
//# contact:     markebby@gmail.com                           #
//#                                                           #
//# description: Dump Arduino Nano EEPROM to Serial           #
//#                                                           #
//#############################################################

//------------------------------------------------------------------------------------------------------------
#include <Streaming.h>
#include <EEPROM.h>

//------------------------------------------------------------------------------------------------------------
//------------------------------------------------------------------------------------------------------------
//------------------------------------------------------------------------------------------------------------
// loop - primary program loop
//------------------------------------------------------------------------------------------------------------
void loop (void)
    {

    }

//------------------------------------------------------------------------------------------------------------
// setup - primary input output and system setup
//------------------------------------------------------------------------------------------------------------
void setup (void)
    {
    int z, i;
    char c    [16];
    int  ci   [16];
    char buff1[16];
    char buff [16];

    Serial.begin (9600);                // init serial

    Serial << "\e[?25h\e[2J\e[H\n";
    Serial << "Dumping Arduino Nano EEPROM" << endl << endl;

    for ( int z = 0;  z < 1024;  z += 16 )
        {
        for ( int i = 0;  i < 16;  i++ )
            {
            c[i] = EEPROM.read (z + i);
            ci[i] = c[i];
            }
        sprintf (buff1, "%04.4X (%d)", z, z);
        sprintf (buff, "%-13s",  buff1);
        Serial << buff;
        for ( int i = 0;  i < 16;  i++ )
            {
            sprintf (buff, "%2.2X ",  c[i] & 0x00FF);
            Serial << buff;
            if ( i == 7 )
                Serial << ' ';
            }
        for ( int i = 0;  i < 16;  i++ )
            {
            Serial << ' ' << c[i];
            if ( i == 7 )
                Serial << ' ';
            }
        Serial << endl;
        }
    }



